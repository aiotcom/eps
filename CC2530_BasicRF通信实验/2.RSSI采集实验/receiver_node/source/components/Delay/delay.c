#include "delay.h"

//==========================================================
//	函数名称：	delay_ms()
//
//	函数功能：	毫秒延时函数
//
//	入口参数：	无
//
//	返回参数：	无
//
//	说明：		
//==========================================================
void delay_ms(uint32_t nms)
{		
    uint16_t i,j;
    
    for (i=0; i<nms; i++)
        for (j=0; j<535; j++);
}

//==========================================================
//	函数名称：	delay_us()
//
//	函数功能：	微秒延时函数
//
//	入口参数：	无
//
//	返回参数：	无
//
//	说明：		
//==========================================================
void delay_us(uint32_t nus)
{		
    uint8_t i;
    
    for (i=0; i<nus; i++);
}


//==========================================================
//	函数名称：	Hal_Init_Mcu()
//
//	函数功能：	时钟初始化
//
//	入口参数：	无
//
//	返回参数：	无
//
//	说明：		
//==========================================================
//void Hal_Init_Mcu(void)
//{
//
//  SLEEPCMD &= ~0X04;//将两个高频的晶振同时上电(即同时开启)
//
//
//  while(!(SLEEPSTA & 0x20) || !(SLEEPSTA & 0x40));//等待两个高频晶振都稳定
//  
//  asm("NOP");
//
//  {
//
//    uint16 i;
//
//    for(i=0;i<504;i++)
//
//    asm("NOP");
//  }
//
//  CLKCONCMD = 0X00;
//  SLEEPCMD |= 0X04;
//
//}


//==========================================================
//	函数名称：	HAL_Set_MainClock()
//
//	函数功能：	选择需要的时钟
//
//	入口参数：	无
//
//	返回参数：	无
//
//	说明：		
//==========================================================
void HAL_Set_MainClock(uint16 source)

{

  register uint16 usc32k_bm = CLKCONCMD & 0X80; //将选择的低频晶振的值保存  
  
  SLEEPCMD &= ~0X04;                             //将两个高频的晶振同时上电(即同时开启)
   
   while(!(SLEEPSTA & 0x20) || !(SLEEPSTA & 0x40)); //等待两个高频晶振都稳定
    asm("NOP");
    {
 
      uint16 i;
 
      for(i=0;i<504;i++) 
      {
        asm("NOP");
      }      
    }
    
    
    if(source ==0)//选择32M的石英晶振
    {
      CLKCONCMD = (usc32k_bm | 0X00);
    }
       
    else          //选择32M的RC晶振
    {
       CLKCONCMD = (usc32k_bm | 0X40 | (0X01<<3) | 0x01);
 //等待设置稳定下来
    }
      
    uint16 cmd = CLKCONCMD;

    
    while(1)

    {

      uint16 sta = CLKCONSTA;
      if(cmd == sta) break;

    }

    
    SLEEPCMD |= 0X04; //去掉没有选择的高频晶振
}


