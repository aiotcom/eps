//#include <stdlib.h>
//#include <string.h>
#include "delay.h"
#include "OLED.h"
#include "IIC.h"
#include <ioCC2530.h>
void OLED_Init_UI(void);
//==========================================================
//	函数名称：	OLED_WrDat()
//
//	函数功能：	OLED写数据
//
//	入口参数：	无
//
//	返回参数：	无
//
//	说明：		
//==========================================================
void OLED_WrDat(unsigned char IIC_Data)
{
    IIC_Start();
    Write_IIC_Byte(0x78);
    Write_IIC_Byte(0x40);			//write data
    Write_IIC_Byte(IIC_Data);
    IIC_Stop();
}
//==========================================================
//	函数名称：	OLED_WrCmd()
//
//	函数功能：	OLED写命令
//
//	入口参数：	无
//
//	返回参数：	无
//
//	说明：		
//==========================================================
void OLED_WrCmd(unsigned char IIC_Command)
{
    IIC_Start();
    Write_IIC_Byte(0x78);       //Slave address,SA0=0
    Write_IIC_Byte(0x00);				//write command
    Write_IIC_Byte(IIC_Command);
    IIC_Stop();
}

//==========================================================
//	函数名称：	OLED_Set_Pos()
//
//	函数功能：	OLED设置坐标
//
//	入口参数：	无
//
//	返回参数：	无
//
//	说明：		
//==========================================================
void OLED_Set_Pos(unsigned char x, unsigned char y) 
{ 
    OLED_WrCmd(0xb0+y);
    OLED_WrCmd(((x&0xf0)>>4)|0x10);
    OLED_WrCmd((x&0x0f)|0x01);
} 

//==========================================================
//	函数名称：	OLED_Fill()
//
//	函数功能：	OLED全屏
//
//	入口参数：	无
//
//	返回参数：	无
//
//	说明：
//==========================================================
void OLED_Fill(unsigned char bmp_dat) 
{
  unsigned char y,x;
  for(y=0;y<8;y++)
  {
      OLED_WrCmd(0xb0+y);
      OLED_WrCmd(0x01);
      OLED_WrCmd(0x10);
      for(x=0;x<X_WIDTH;x++)
      {
          OLED_WrDat(bmp_dat);
      }
  }
}


//==========================================================
//	函数名称：	OLED_CLS()
//
//	函数功能：	OLED复位
//
//	入口参数：	无
//
//	返回参数：	无
//
//	说明：
//==========================================================
void OLED_CLS(void)
{
  unsigned char y,x;
  for(y=0;y<8;y++)
  {
      OLED_WrCmd(0xb0+y);
      OLED_WrCmd(0x01);
      OLED_WrCmd(0x10);
      for(x=0;x<X_WIDTH;x++)
      OLED_WrDat(0);
  }
}
//==========================================================
//	函数名称：	OLED_Init()
//
//	函数功能：	OLED初始化
//
//	入口参数：	无
//
//	返回参数：	无
//
//	说明：		
//==========================================================
void OLED_Init(void)
{
    IIC_Init();//初始IIC总线
    delay_ms(500);            
    OLED_WrCmd(0xae);       
    OLED_WrCmd(0x00);      
    OLED_WrCmd(0x10);       
    OLED_WrCmd(0x40);       
    OLED_WrCmd(0x81);      
    OLED_WrCmd(Brightness); 
    OLED_WrCmd(0xa1);       
    OLED_WrCmd(0xc8);       
    OLED_WrCmd(0xa6);      
    OLED_WrCmd(0xa8);       
    OLED_WrCmd(0x3f);       
    OLED_WrCmd(0xd3);       
    OLED_WrCmd(0x00);       
    OLED_WrCmd(0xd5);       
    OLED_WrCmd(0x80);       
    OLED_WrCmd(0xd9);       
    OLED_WrCmd(0xf1);       
    OLED_WrCmd(0xda);       
    OLED_WrCmd(0x12);
    OLED_WrCmd(0xdb);       
    OLED_WrCmd(0x40);       
    OLED_WrCmd(0x20);      
    OLED_WrCmd(0x02); 
    OLED_WrCmd(0x8d);       
    OLED_WrCmd(0x14);       
    OLED_WrCmd(0xa4);      
    OLED_WrCmd(0xa6);       
    OLED_WrCmd(0xaf);       
    OLED_Fill(0x00);        
    OLED_Set_Pos(0,0);
    OLED_Fill(0xff);  //全屏亮
    delay_ms(50); 
    OLED_Fill(0x00);  //全屏灭
    OLED_CLS();       //清屏
    
//    OLED_Init_UI();
    //OLED_P6x8Str(1,1,"123456");
} 
//==========================================================
//	函数名称：	OLED_P6x8Str()
//
//	函数功能：	显示6*8一组标准ASCLL字符串
//
//	入口参数：	显示坐标(X,Y) y(0~7)
//
//	返回参数：	无
//
//	说明：		
//==========================================================
void OLED_P6x8Str(unsigned char x, unsigned char y,unsigned char ch[])
{
    unsigned char c=0,i=0,j=0;
    while (ch[j]!='\0')
    {
        c =ch[j]-32;
        if(x>126){x=0;y++;}
        OLED_Set_Pos(x,y);
        for(i=0;i<6;i++)
        OLED_WrDat(F6x8[c][i]);
        x+=6;
        j++;
    }
}


//==========================================================
//	函数名称：	OLED_P8x16Str()
//
//	函数功能：	显示8*16一组标准ASCLL字符串
//
//	入口参数：	显示坐标(X,Y) y(0~7)
//
//	返回参数：	无
//
//	说明：		
//==========================================================
void OLED_P8x16Str(unsigned char x, unsigned char y,unsigned char ch[])
{
    unsigned char c=0,i=0,j=0;
    while (ch[j]!='\0')
    {
        c =ch[j]-32;
        if(x>120){x=0;y++;}
        OLED_Set_Pos(x,y);
        for(i=0;i<8;i++)
        OLED_WrDat(F8X16[c*16+i]);
        OLED_Set_Pos(x,y+1);
        for(i=0;i<8;i++)
        OLED_WrDat(F8X16[c*16+i+8]);
        x+=8;
        j++;
    }
}


//==========================================================
//	函数名称：	OLED_P16x16Ch()
//
//	函数功能：	显示16*16点阵
//
//	入口参数：	显示坐标(X,Y) y(0~7)
//
//	返回参数：	无
//
//	说明：		
//==========================================================
void OLED_P16x16Ch(unsigned char x, unsigned char y, unsigned char N)
{
    unsigned char wm=0;
    unsigned int adder=32*N;
    OLED_Set_Pos(x , y);
    for(wm = 0;wm < 16;wm++)
    {
        OLED_WrDat(F16x16[adder]);
        adder += 1;
    }
    OLED_Set_Pos(x,y + 1);
    for(wm = 0;wm < 16;wm++)
    {
        OLED_WrDat(F16x16[adder]);
        adder += 1;
    } 	  	
}

//==========================================================
//	函数名称：	Draw_BMP()
//
//	函数功能：	显示BMP图片128X64
//
//	入口参数：	X:0~127  Y:0~7
//
//	返回参数：	无
//
//	说明：		
//==========================================================
void Draw_BMP(unsigned char x0, unsigned char y0,unsigned char x1, unsigned char y1,unsigned char BMP[])
{
  unsigned int j=0;
  unsigned char x,y;

  if(y1%8==0) y=y1/8;      
  else y=y1/8+1;
    for(y=y0;y<y1;y++)
    {
        OLED_Set_Pos(x0,y);
        for(x=x0;x<x1;x++)
        {      
            OLED_WrDat(BMP[j++]);
        }
    }
}


//==========================================================
//	函数名称：	OLED_DrawLineX
//
//	函数功能：	画水平线
//
//	入口参数：	x1,y1:起点坐标
//              x2:终点坐标 
//							Data:数据
//              
//	返回参数：	无
//
//	说明：		
//==========================================================
void OLED_DrawLineX(uint16 x1, uint16 y1, uint16 x2,uint16 Data)
{
    static uint32 i = 0;
    if(x1>126 || y1>7 || x2>126)
    {
       x1=0;y1=0;x2=0;
    }
    OLED_Set_Pos(x1,y1);
    
    for(i=0;i<(x2-x1);i++)
    {
       OLED_WrDat(Data);
    }
}


//==========================================================
//	函数名称：	OLED_DrawLineY
//
//	函数功能：	画竖直线
//
//	入口参数：	x1,y1:起点坐标
//                      y2:终点坐标 
//			Data:数据
//              
//	返回参数：	无
//
//	说明：		
//==========================================================
void OLED_DrawLineY(uint16 x1, uint16 y1, uint16 y2,uint16 Data)
{
    static uint32 i = 0;
    if(x1>126  || y1>7 || y2>7 )
    {
         x1=0;y1=0;y2=0;
    }
    
    for(i=y1;i<=y2;i++)
    {
        OLED_Set_Pos(x1,i);
        OLED_WrDat(Data);
    }	
}


//==========================================================
//	函数名称：	OLED_Init_UI()
//
//	函数功能：	OLED初始化界面
//
//	入口参数：	无
//
//	返回参数：	无
//
//	说明：		
//==========================================================
void OLED_Init_UI(void)
{	
    OLED_P16x16Ch(30,2,1);  //阶
//    OLED_P16x16Ch(50,2,2);  //石
//    OLED_P16x16Ch(70,2,3);  //物
//    OLED_P16x16Ch(90,2,4);  //联
//    OLED_P8x16Str(3,4,"www.stepiot.com");
}



const unsigned char  F16x16[] = 	  	 
{
0x00,0x00,0x00,0x00,0x00,0x00,0x00,0x00,0x00,0x00,0x00,0x00,0x00,0x00,0x00,0x00,/*" ",0*/
0x00,0x00,0x00,0x00,0x00,0x00,0x00,0x00,0x00,0x00,0x00,0x00,0x00,0x00,0x00,0x00,/*" ",0*/
	
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0x10,0x1F,0x08,0x08,0xFF,0x04,0x81,0x41,0x31,0x0D,0x03,0x0D,0x31,0x41,0x81,0x00,/*"联",4*/
};
const  unsigned char  F6x8[][6] =
{
0x00, 0x00, 0x00, 0x00, 0x00, 0x00,// sp
0x00, 0x00, 0x00, 0x2f, 0x00, 0x00,// !
0x00, 0x00, 0x07, 0x00, 0x07, 0x00,// "
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0x14, 0x14, 0x14, 0x14, 0x14, 0x14,// horiz lines
};
/****************************************8*16************************************/
const unsigned char  F8X16[]=	  
{
  0x00,0x00,0x00,0x00,0x00,0x00,0x00,0x00,0x00,0x00,0x00,0x00,0x00,0x00,0x00,0x00,// 0
  0x00,0x00,0x00,0xF8,0x00,0x00,0x00,0x00,0x00,0x00,0x00,0x33,0x30,0x00,0x00,0x00,//! 1
  0x00,0x10,0x0C,0x06,0x10,0x0C,0x06,0x00,0x00,0x00,0x00,0x00,0x00,0x00,0x00,0x00,//" 2
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  0x00,0x06,0x01,0x01,0x02,0x02,0x04,0x04,0x00,0x00,0x00,0x00,0x00,0x00,0x00,0x00,//~ 94
};

