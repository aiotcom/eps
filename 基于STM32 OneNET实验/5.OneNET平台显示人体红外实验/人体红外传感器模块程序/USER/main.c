#include "stm32f1xx_hal.h"
#include "stm32f1xx.h"
#include "Rs485.h"
#include "usart.h"
#include "delay.h"
#include "PIR.h"
#include "timer.h"
/**
************************************************************
************************************************************
************************************************************
*
*	作者： 		重庆八城科技
*
*	日期： 		2019-12-11
*
*	版本： 		V2.0
*
*	说明： 		人体红外模块
*
*	修改记录：	
************************************************************
************************************************************
************************************************************
**/

void RS485_HandlerCb(void);
int main(void)
{
    HAL_Init();						//初始化HAL库 
    PIR_Init();						//初始化人体红外
    UART1_Init(115200);		//初始化串口1
    USART3_Init(115200);          //用于调试
    Rs485_Init();					//初始化485  
    printf("this is usart3 print\r\n");
    /*中断频率10HZ 关联回调函数RS485_HandlerCb*/
    TIM3_Init(10000-1,640-1,RS485_HandlerCb);    
    while(1)
    {
        if(PIR_Read())
        {//读到人体红外
            PIR_Sta[0] = 1;
        }
        else
        {//没有读到人体红外
            PIR_Sta[0] = 0;
        }
    }
}
//==========================================================
//	函数名称：	void RS485_HandlerCb(void)
//
//	函数功能：	通过485总线获取数据处理函数
//
//	入口参数：	void
//
//	返回参数：	无
//
//	说明：		接收通过485总线发送过来的数据请求
//==========================================================
void RS485_HandlerCb(void)
{
    if(!DataHandling_485(Addr_PIR))		//收到请求
    {
        printf("get requery\r\n");//串口打印
        Rs485_Send(Addr_PIR,Addr_WiFi,PIR_State,1,PIR_Sta);		//发送人体红外状态
    }
}
