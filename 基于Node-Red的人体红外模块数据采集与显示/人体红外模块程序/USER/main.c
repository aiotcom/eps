#include "stm32f1xx_hal.h"
#include "stm32f1xx.h"
#include "Rs485.h"
#include "usart.h"
#include "delay.h"
#include "PIR.h"

/**
************************************************************
************************************************************
************************************************************
*
*	作者： 		重庆八城科技
*
*	日期： 		2019-12-11
*
*	版本： 		V2.0
*
*	说明： 		人体红外模块
*
*	修改记录：	
************************************************************
************************************************************
************************************************************
**/


int main(void)
{
  HAL_Init();						//初始化HAL库 
	PIR_Init();						//初始化人体红外
	Rs485_Init();					//初始化485
	UART1_Init(115200);		//初始化串口1

	while(1)
	{
		if(PIR_Read())
		{
			PIR_LED_ON();
			PIR_Sta[0] = 1;
		}
		else
		{
			PIR_LED_OFF();
			PIR_Sta[0] = 0;
		}

		if(!DataHandling_485(Addr_PIR))		//处理485数据
		{
			Rs485_Send(Addr_PIR,Rx_Stack.Src_Adr,PIR_State,1,PIR_Sta);		//发送人体红外状态
		}
	}
}

